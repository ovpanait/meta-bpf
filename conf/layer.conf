## conf/layer.conf
```bitbake
# We have a conf and classes directory, add to BBPATH
BBPATH .= ":${LAYERDIR}"

# We have recipes-* directories, add to BBFILES
BBFILES += "${LAYERDIR}/recipes-*/*/*.bb ${LAYERDIR}/recipes-*/*/*.bbappend"

BBFILE_COLLECTIONS += "bpf"
BBFILE_PATTERN_bpf = "^${LAYERDIR}/"
BBFILE_PRIORITY_bpf = "1"

# This should only be incremented on significant changes that will
# cause compatibility issues with other layers
LAYERVERSION_bpf = "1"

LAYERDEPENDS_bpf = "core"

LAYERSERIES_COMPAT_bpf = "zeus"
```
